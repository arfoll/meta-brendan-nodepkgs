## conf/layer.conf
```bitbake
# We have a conf and classes directory, add to BBPATH
BBPATH .= ":${LAYERDIR}"

# We have a recipes directory, add to BBFILES
BBFILES += "${LAYERDIR}/recipes-*/*/*.bb \
	${LAYERDIR}/recipes-*/*/*.bbappend"

BBFILE_COLLECTIONS += "brendan-nodepkgs"
BBFILE_PATTERN_brendan-nodepkgs := "^${LAYERDIR}/"
BBFILE_PRIORITY_brendan-nodepkgs = "8"
```
